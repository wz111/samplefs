## Kconfig
```kconfig
config SAMPLEFS_FS
        tristate "Sample filesystem (EXPERIMENTAL)"
        help
          Samplefs is a sample filesystem for learning how to build
          a simple Linux filesystem

          If unsure, say N.

config SAMPLEFS_DEBUG
	bool "Additional debugging statements for samplefs"
	depends on SAMPLEFS_FS
	help
           Enabling this option adds a few more debugging routines
           to the samplefs code which slightly increases the size of
           the samplefs module and can cause additional logging of debug
           messages in some error paths, slowing performance. This
           option can be turned off unless you are debugging
           samplefs problems.  If unsure, say N.
```
